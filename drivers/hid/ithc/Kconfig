## drivers/hid/ithc/Kconfig
```kconfig
# SPDX-License-Identifier: GPL-2.0-or-later

config HID_ITHC
	tristate "Intel Touch Host Controller"
	depends on PCI
	depends on HID
	help
	  Say Y here if your system has a touchscreen using Intels
	  Touch Host Controller (ITHC) technology.

	  If unsure say N.

	  To compile this driver as a module, choose M here: the
	  module will be called ithc.
```
